/* Define to prevent recursive inclusion -------------------------------------*/
#ifndef _READTEMP_C
#define _READTEMP_C

#include "Adc.h"
#include "Readtemp.h"
#include "Process.h"

const unsigned short temp_AD[801]=
{
  0,39,79,119,158,198,238,277,317,357,
  397,437,477,517,557,597,637,677,718,758,
  798,838,879,919,960,1000,1041,1081,1122,1163,
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  32865,32906,32947,32988,33029,33070,33111,33152,33193,33234
};


unsigned short read_temper(void)
{
  unsigned short vlotage;
  unsigned short temp;
  vlotage=AD_slove();
  vlotage=  (unsigned short)(vlotage*7.9768719);//计算电压值  
  if((Environment_temp<801)&&(Environment_temp>0))
   vlotage=vlotage+temp_AD[Environment_temp];
  
  if(vlotage<33234)
    temp=Get_Temp(vlotage);
  else
    temp=0;
  return temp;
}

unsigned short Get_Temp(unsigned short vlotage)
{
   unsigned short First=0;
   unsigned short End=800;
   unsigned short Difference;
   for(unsigned char i=0;i<11;i++)
   {
      Difference=End-First;
      if(Difference>1)  //
      {
        Difference=Difference/2+First;
        if(vlotage>temp_AD[Difference])
        {
          First=Difference;
        }
        else if(vlotage<temp_AD[Difference])
        {
          End=Difference;
        }
        else
        {
          return Difference;
        }
      }
      else
      {
         if((temp_AD[End]-vlotage)<(vlotage-temp_AD[First]))
           return End;
         else
           return First;
      }
   }
   return 0;
}


#endif